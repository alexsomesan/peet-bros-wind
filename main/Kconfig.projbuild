## main/Kconfig.projbuild
```kconfig
menu "Windvane Configuration"

config ESPNOW_CHANNEL
    int "Channel"
    default 1
    range 1 13
    help
        The channel on which sending and receiving ESPNOW data.
  
config ESPNOW_SEND_DELAY
    int "Send delay"
    default 1000
    range 0 65535
    help
        Delay between sending two ESPNOW data, unit: ms.
        
config ESPNOW_SEND_LEN
    int "Send len"
    range 10 250
    default 200
    help
        Length of ESPNOW data to be sent, unit: byte.

endmenu
```
